## Kconfig
```kconfig
#
# For a description of the syntax of this configuration file,
# see Documentation/kbuild/kconfig-language.txt.
#
mainmenu "Linux/$ARCH $KERNELVERSION Kernel Configuration"

config SRCARCH
	string
	option env="SRCARCH"

source "arch/$SRCARCH/Kconfig"

config NO_ERROR_ON_MISMATCH
	bool "No error on symbol mismatches"
	default n
	help
	   Fix compile for some targets

config LTO
	bool
	help
	  Selected by each link time optimization option. Kbuild keys the
	  thin-archive built-in objects, the export CRC scripts kept beside
	  each object, the per-initcall sections and the relocatable vmlinux
	  prelink on this symbol; the compiler-specific option names the
	  compile flags and the linker that run the prelink.
```

## arch/arm/Kconfig.lto
```kconfig
config LTO_CLANG_THIN
	bool "Clang ThinLTO for vmlinux"
	depends on ARCH_MSM8226 && !FUNCTION_TRACER
	default n
	select LTO
	help
	  Compile the kernel to LLVM bitcode and link vmlinux through one
	  relocatable ThinLTO link in ld.lld. That prelink rebuilds the
	  initcall sections in source link order and applies the genksyms
	  export CRCs; modpost, kallsyms and the final vmlinux link read its
	  native output. The build needs LLVM=1, and Kbuild stops before
	  compiling with any other toolchain.

	  The prelink covers vmlinux alone: the module build stops with an
	  error when any module is selected, and the function tracer, whose
	  mcount records need a native object per compile, stays disabled.

	  If unsure, say N.

config LTO_GCC
	bool "GCC link time optimization for vmlinux"
	depends on ARCH_MSM8226 && !FUNCTION_TRACER && !LTO_CLANG_THIN
	default n
	select LTO
	help
	  Compile the kernel C objects to GCC GIMPLE beside their native
	  code (fat LTO objects) and link vmlinux through one relocatable
	  LTO link that gcc runs through scripts/gcc-ld and the linker
	  plugin. That prelink rebuilds the initcall sections in source link
	  order and applies the genksyms export CRCs; modpost, kallsyms and
	  the final vmlinux link read its native output. Kernel C compiles
	  with -fno-pic. An object whose own -f, -m, -O, -g or -Wa, options
	  differ from the kernel-wide set compiles natively, because GCC 4.9
	  builds every LTO partition with the options of the link command.
	  The build needs the GCC toolchain; Kbuild stops under LLVM=1.

	  The prelink covers vmlinux alone: the module build stops with an
	  error when any module is selected, and the function tracer, whose
	  mcount records need a native object per compile, stays disabled.
	  CONFIG_LTO_CLANG_THIN and this option exclude each other.

	  If unsure, say N.
```
